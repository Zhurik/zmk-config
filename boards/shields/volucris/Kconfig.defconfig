## boards/shields/volucris/Kconfig.defconfig
```kconfig
# Copyright (c) 2026
# SPDX-License-Identifier: MIT

if SHIELD_VOLUCRIS_LEFT

config ZMK_KEYBOARD_NAME
    default "Volucris"

config ZMK_SPLIT_ROLE_CENTRAL
    default y

endif

if SHIELD_VOLUCRIS_LEFT || SHIELD_VOLUCRIS_RIGHT

config ZMK_SPLIT
    default y

endif
```

## boards/shields/volucris/Kconfig.shield
```kconfig
# Copyright (c) 2026
# SPDX-License-Identifier: MIT

config SHIELD_VOLUCRIS_LEFT
    def_bool $(shields_list_contains,volucris_left)

config SHIELD_VOLUCRIS_RIGHT
    def_bool $(shields_list_contains,volucris_right)
```
